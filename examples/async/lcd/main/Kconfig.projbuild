## examples/async/lcd/main/Kconfig.projbuild
```kconfig
menu "JPEG LCD Pan Example"

    config JPEG_URL
        string "JPEG image URL"
        default "https://i.gzn.jp/img/2009/06/18/lenna/000.jpg"
        help
            Full URL of the JPEG image to fetch and display.
            Must be accessible from the device's WiFi network.
            HTTPS is supported via the bundled CA certificates.

    config PAN_X_MAX
        int "Maximum pan X offset (pixels)"
        default 320
        help
            image_width - LCD_W.  Set to 0 if the image fits
            within the display width (no horizontal panning).

    config PAN_Y_MAX
        int "Maximum pan Y offset (pixels)"
        default 480
        help
            image_height - LCD_H.  Set to 0 if the image fits
            within the display height (no vertical panning).

    config PAN_STEP_X
        int "Horizontal pan step per frame (pixels)"
        default 20
        help
            Pixels to advance horizontally between frames.
            Smaller = smoother pan, more HTTP requests per second.

    config PAN_STEP_Y
        int "Vertical pan step per row-wrap (pixels)"
        default 20
        help
            Pixels to step downward each time the horizontal
            sweep bounces off a wall.

endmenu
```

## examples/async/sdcard/main/Kconfig.projbuild
```kconfig
menu "SD Card (SDSPI)"

config SD_SPI_HOST
    int "SPI host number"
    default 2
    help
        SPI host to use (SPI2_HOST or SPI3_HOST)

config SD_SPI_MOSI
    int "MOSI GPIO"
    default 23

config SD_SPI_MISO
    int "MISO GPIO"
    default 19

config SD_SPI_SCLK
    int "SCLK GPIO"
    default 18

config SD_SPI_CS
    int "CS GPIO"
    default 5

config SD_MOUNT_POINT
    string "Mount point"
    default "/sdcard"

endmenu
```

## examples/esp32/ipcam/main/Kconfig.projbuild
```kconfig
menu "JPEG IP Camera Example"

    config IPCAM_URL
        string "IP Camera Snapshot URL"
        default "http://192.168.10.15:85/images/snapshot.jpg"
        help
            IP Camera Snapshot URL
endmenu
```
