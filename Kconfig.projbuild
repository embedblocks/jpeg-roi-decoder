## Kconfig.projbuild
```kconfig
menu "JPEG Decoder Configuration"

    config JPEG_QUEUE_DEPTH
        int "Decode request queue depth"
        default 5
        range 1 20
        help
            Maximum number of pending decode requests that can be queued.

    config JPEG_TASK_STACK_SIZE
        int "Decode task stack size (bytes)"
        default 8192
        range 4096 32768
        help
            Stack size for the JPEG decode worker task.
            Increase if you experience stack overflow errors.

    config JPEG_TASK_PRIORITY
        int "Decode task priority"
        default 5
        range 1 24
        help
            FreeRTOS task priority for the JPEG decode worker.

    config JPEG_INPUT_BUFFER_SIZE
        int "Input buffer size (bytes)"
        default 512
        range 128 4096
        help
            Size of the buffer used to read JPEG data from file.
            Larger buffers reduce read frequency but consume more memory.

    config JPEG_POOL_SIZE
        int "Working memory pool size (bytes)"
        default 3100
        range 2048 8192
        help
            Memory pool size for JPEG decoder working buffers.
            Do not reduce below 3100 bytes.

    config JPEG_QUEUE_TIMEOUT_MS
        int "Queue send timeout (milliseconds)"
        default 100
        range 0 10000
        help
            Timeout when queuing decode requests.
            0 = no wait (fail immediately if queue full)

endmenu
```

## examples/async/sdcard/sdkconfig.defaults
```kconfig
CONFIG_SD_SPI_HOST=2
CONFIG_SD_SPI_MOSI=23
CONFIG_SD_SPI_MISO=19
CONFIG_SD_SPI_SCLK=18
CONFIG_SD_SPI_CS=5
CONFIG_SD_MOUNT_POINT="/sdcard"
```

## examples/esp32/http/main/Kconfig
```kconfig
menu "JPEG HTTP Stream Example"

    config JPEG_URL
        string "JPEG Image URL"
        default "https://i.gzn.jp/img/2009/06/18/lenna/000.jpg"
        help
            HTTP/HTTPS URL of the JPEG image to stream and decode.

endmenu
```
